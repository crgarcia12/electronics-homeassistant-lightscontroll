## firmware/lightcontrol/sdkconfig.defaults.esp32s3
```kconfig
#
# Please Note:
# ESP32-S3-DevKitC v1.1 uses GPIO38 for the on-board LED
# ESP32-S3-DevKitC v1.0 uses GPIO48 for the on-board LED
#
# C++ Configuration for ESP32-S3
CONFIG_COMPILER_CXX_EXCEPTIONS=y
CONFIG_COMPILER_CXX_RTTI=y
```

## tester-code/idf/lightcontrol/sdkconfig.defaults
```kconfig
# I2C Debug Configuration
CONFIG_I2C_ENABLE_DEBUG_LOG=y

# C++ Configuration
CONFIG_COMPILER_CXX_EXCEPTIONS=y
CONFIG_COMPILER_CXX_RTTI=y
```

## tester-code/idf/lightcontrol/sdkconfig.defaults.esp32s3
```kconfig
#
# Please Note:
# ESP32-S3-DevKitC v1.1 uses GPIO38 for the on-board LED
# ESP32-S3-DevKitC v1.0 uses GPIO48 for the on-board LED
#
CONFIG_BLINK_GPIO=1

I2C_MASTER_SDA_IO=42
I2C_MASTER_SCL_IO=41
GPIO_PULLUP_ENABLE=false
GPIO_PULLUP_ENABLE=false
```
